## conf/layer.conf
```bitbake
# We have a conf and classes directory, add to BBPATH
BBPATH .= ":${LAYERDIR}"

# We have recipes-* directories, add to BBFILES
BBFILES += "${LAYERDIR}/recipes-*/*/*.bb \
            ${LAYERDIR}/recipes-*/*/*.bbappend"

BBFILE_COLLECTIONS += "meta-glmf"
BBFILE_PATTERN_meta-glmf = "^${LAYERDIR}/"
BBFILE_PRIORITY_meta-glmf = "6"

LAYERDEPENDS_meta-glmf = "core"
LAYERSERIES_COMPAT_meta-glmf = "thud"
```
